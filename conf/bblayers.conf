## conf/bblayers.conf
```bitbake
# LAYER_CONF_VERSION is increased each time build/conf/bblayers.conf
# changes incompatibly
LCONF_VERSION = "6"

BBPATH = "${TOPDIR}"
BBFILES ?= ""

BBLAYERS ?= " \
  /build/clanton_v1/meta \
  /build/clanton_v1/meta-yocto \
  /build/clanton_v1/meta-intel-iot-devkit \
  /build/clanton_v1/meta-intel-iot-middleware \
  /build/clanton_v1/meta-intel-quark \
  /build/clanton_v1/meta-intel-galileo \
  /build/clanton_v1/meta-netcontiki \
  /build/clanton_v1/meta-openembedded/meta-networking \
  "
BBLAYERS_NON_REMOVABLE ?= " \
  /build/clanton_v1/meta \
  /build/clanton_v1/meta-yocto \
  "
```
